## EDF/build/conf/bblayers.conf
```bitbake
POKY_BBLAYERS_CONF_VERSION = "2"

BBPATH = "${TOPDIR}"
BBFILES ?= ""

BBLAYERS ?= " \
  /tools/edf/poky/meta \
  /tools/edf/poky/meta-poky \
  /tools/edf/meta-arm/meta-arm \
  /tools/edf/meta-arm/meta-arm-toolchain \
  /tools/edf/meta-xilinx/meta-xilinx-core \
  /tools/edf/meta-xilinx/meta-xilinx-bsp \
  /tools/edf/meta-xilinx/meta-xilinx-standalone \
  /tools/edf/meta-xilinx/meta-xilinx-standalone-sdt \
  /tools/edf/meta-xilinx/meta-microblaze \
  /tools/edf/meta-xilinx/meta-xilinx-multimedia \
  /tools/edf/meta-xilinx-tools \
  /tools/edf/meta-openembedded/meta-oe \
  /tools/edf/meta-openembedded/meta-python \
  /tools/edf/meta-openembedded/meta-networking \
  /tools/edf/meta-openembedded/meta-filesystems \
  /tools/edf/meta-virtualization \
  /tools/edf/meta-amd-adaptive-socs/meta-amd-adaptive-socs-core \
  /tools/edf/meta-amd-adaptive-socs/meta-amd-adaptive-socs-bsp \
  /home/edf/projects/EDF/sources/meta-zcu104-ddr4 \
  "
```

## EDF/sources/meta-zcu104-ddr4/conf/layer.conf
```bitbake
# We have a conf and classes directory, add to BBPATH
BBPATH .= ":${LAYERDIR}"

# We have recipes-* directories, add to BBFILES
BBFILES += "${LAYERDIR}/recipes-*/*/*.bb \
            ${LAYERDIR}/recipes-*/*/*.bbappend"

BBFILE_COLLECTIONS += "meta-zcu104-ddr4"
BBFILE_PATTERN_meta-zcu104-ddr4 = "^${LAYERDIR}/"
BBFILE_PRIORITY_meta-zcu104-ddr4 = "6"

LAYERDEPENDS_meta-zcu104-ddr4 = "core"
LAYERSERIES_COMPAT_meta-zcu104-ddr4 = "scarthgap"
```
