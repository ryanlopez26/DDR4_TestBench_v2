## EDF/build/conf/local.conf
```bitbake
# standard
MACHINE = "zynqmp-zcu104-sdt-full"
DISTRO = "poky"
DL_DIR = "/tools/edf/downloads"
SSTATE_DIR = "/tools/edf/sstate-cache"
BB_NUMBER_THREADS = "24"
PARALLEL_MAKE = "-j 8"
IMAGE_FSTYPES = "wic wic.bmap ext4"
IMAGE_ROOTFS_EXTRA_SPACE = "131072"
IMAGE_INSTALL:append = " devmem2 openssh zcu-server"
KERNEL_EXTRA_FEATURES:append = " features/devmem/devmem.scc"
EXTRA_IMAGE_FEATURES ?= "debug-tweaks"
PATCHRESOLVE = "noop"
USER_CLASSES ?= "buildstats"
CONF_VERSION = "2"

DISTRO = "poky"
BBMULTICONFIG ?= ""
DISTRO_FEATURES:remove = "xen"
DISTRO_FEATURES:remove = "xen"
DISTRO_FEATURES:append = " systemd"
INIT_MANAGER = "systemd"
DISTRO_FEATURES_BACKFILL_CONSIDERED += "sysvinit"
ENABLE_XEN_DTSI:forcevariable = ""
ENABLE_XEN_QEMU_DTSI:forcevariable = ""
# Set hostname for the image
hostname:pn-base-files = "zcu104-ddr4"
PREFERRED_PROVIDER_virtual/bitstream = "bitstream-manual"
MACHINE_FEATURES:remove = "fpga-overlay"
IMAGE_INSTALL:append = " libgpiod libgpiod-tools fpga-manager-script tmux btop"

# Enable systemd-networkd as the network manager
IMAGE_INSTALL:append = " systemd-conf"
PACKAGECONFIG:append:pn-systemd = " networkd resolved"

# Remove features not needed for headless DDR4 memory tester
DISTRO_FEATURES:remove = " \
    alsa \
    bluetooth \
    debuginfod \
    pcmcia \
    usbgadget \
    wifi \
    nfs \
    zeroconf \
    pci \
    3g \
    nfc \
    x11 \
    opengl \
    ptest \
    multiarch \
    wayland \
    vulkan \
    pulseaudio \
    gobject-introspection-data \
"

# --- /dvr data partition (FAT32, readable on Windows) ---
WKS_FILE = "zcu104-ddr4-dvr.wks"
IMAGE_INSTALL:append = " dosfstools"
IMAGE_INSTALL:append = " dvr-resize"

# alternative to SRC_URI:remove — in local.conf
BBMASK += "meta-xilinx-core/recipes-core/systemd/systemd_%\.bbappend"
```
